## boards/arm/ble_micro_pro/Kconfig.board
```kconfig
# SPDX-License-Identifier: MIT

config BOARD_BLE_MICRO_PRO
    bool "BLE Micro Pro"
    depends on SOC_NRF52840_QIAA
```

## boards/arm/ble_micro_pro/Kconfig.defconfig
```kconfig
# SPDX-License-Identifier: MIT

if BOARD_BLE_MICRO_PRO

if USB_DEVICE_STACK

config USB_NRFX
    default y

endif # USB_DEVICE_STACK

config BT_CTLR
    default BT

endif
```
